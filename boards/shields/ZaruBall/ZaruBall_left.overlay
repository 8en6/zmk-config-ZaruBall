#include "ZaruBall.dtsi"

&kscan0 {
    // V3.2に合わせて ACTIVE_LOW に変更
    gpios
        = <&xiao_d 0 GPIO_ACTIVE_LOW> // M1
        , <&xiao_d 1 GPIO_ACTIVE_LOW> // M2
        , <&xiao_d 2 GPIO_ACTIVE_LOW> // M3
        , <&xiao_d 3 GPIO_ACTIVE_LOW> // M4
        , <&xiao_d 4 GPIO_ACTIVE_LOW> // M5
        , <&xiao_d 5 GPIO_ACTIVE_LOW> // M6
        , <&xiao_d 6 GPIO_ACTIVE_LOW> // M7

        , <&xiao_d 9 GPIO_ACTIVE_LOW> // T1
        , <&xiao_d 8 GPIO_ACTIVE_LOW> // T2
        , <&xiao_d 7 GPIO_ACTIVE_LOW> // T3
        // V3.2の親指キー用NFCピン (Xiao BLEの内部ピン)
        , <&gpio0 9  GPIO_ACTIVE_LOW> // T4 (NFC1)
        , <&gpio0 10 GPIO_ACTIVE_LOW> // T5 (NFC2)
        ;
    // 左手用割り込みピン (不要なら削除しても動きますが念のためV3用に)
    interrupt-gpios = <&xiao_d 10 (GPIO_ACTIVE_LOW | GPIO_PULL_UP)>;
};

&left_encoder {
    status = "okay";
};
